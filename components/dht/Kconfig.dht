## components/dht/Kconfig.dht
```kconfig
menu "Sensor DHT"

    config BIT_DHT_EN
        bool "Enable DHT"
        default y

    config DHT_GPIO_PIN
        int "DHT GPIO PIN"
        range 0 48
        default 7

    config DHT_TYPE
        int "DHT TYPE"
        default 0
    
    config DHT_READ_INTERVAL_MS
        int "DHT READ INTERVAL MS"
        range 2000 10000
        default 2000

    config DHT_TASK_PRIORITY
        int "DHT task priority"
        default 6
    
    config DHT_STACK_SIZE
        int "DHT stack size"
        default 4096

    config DHT_PANNE_SEUIL_CONSECUTIF
        int "DHT PANNE SEUIL CONSECUTIF"
        default 3
        range 1 20

    config DHT_SETUP_DELAY
        int "DHT SETUP DELAY"
        default 500

    config DHT_TEMP_DELTA
        string "DHT Temperature Delta (°C)"
        default "0.1"
        help
            Variation minimale de température pour déclencher une publication (Format: float string).

    config DHT_HUM_DELTA
        string "DHT Humidity Delta (%)"
        default "1.0"
        help
            Variation minimale d'humidité pour déclencher une publication (Format: float string).

    config DHT_HEARTBEAT_MS
        int "DHT Heartbeat Interval (ms)"
        default 60000
        help
            Temps maximum (en ms) avant de forcer une publication, même sans variation de delta.

endmenu
```

## components/event_bus/Kconfig.event_bus
```kconfig
menu "Event bus"

    config EVENT_LOW_DROP_THRESHOLD
        int "EVENT LOW DROP THRESHOLD"
        default 100

    config SUBSCRIBER_QUEUE_SIZE
        int "SUBSCRIBER QUEUE SIZE"
        default 10

endmenu
```

## components/relay/Kconfig.relay
```kconfig
menu "Relais Configuration"

    config RELAY_GPIO_PIN
        int "Relay GPIO Pin"
        range 0 48
        default 20
        help
            Le numero du GPIO sur lequel est branche le relais de commande de la chaudiere.

    config RELAY_INVERTED
        bool "Inverser la logique du relais"
        default y
        help
            Cochez si le relais s'active avec un niveau BAS (0V).

    config RELAY_MIN_DELAY_SEC
        int "Delai minimum entre commutations (secondes)"
        range 0 3600
        default 60
        help
            Empeche le relais de changer d'etat trop rapidement pour proteger la chaudiere.

    config RELAY_TASK_PRIORITY
        int "DHT task priority"
        default 5
    
    config RELAY_STACK_SIZE
        int "DHT stack size"
        default 4096

    endmenu
```

## components/sht31/KConfig.sht31
```kconfig
menu "Sensor SHT31"

    config SHT31_ENABLE
        bool "Enable SHT31"
        default y
        help
            Activer ou désactiver le pilote et la tâche du capteur SHT31.

    config SHT31_DEFAULT_ADDR
        hex "SHT31 I2C Address"
        default 68
        help
            Adresse I2C par défaut du SHT31 (Généralement 0x44, ou 0x45 si pin ADDR à l'état haut).

    config SHT31_DEFAULT_READ_INTERVAL_MS
        int "SHT31 Read Interval (ms)"
        default 5000
        help
            Intervalle de lecture par défaut (en ms).

    config SHT31_TASK_PRIORITY
        int "SHT31 task priority"
        default 6
    
    config SHT31_STACK_SIZE
        int "SHT31 stack size"
        default 4096

    config SHT31_TEMP_DELTA
        string "SHT31 Temperature Delta (°C)"
        default "0.1"
        help
            Variation minimale de température pour déclencher une publication (Format: float string).

    config SHT31_HUM_DELTA
        string "SHT31 Humidity Delta (%)"
        default "1.0"
        help
            Variation minimale d'humidité pour déclencher une publication (Format: float string).

    config SHT31_HEARTBEAT_MS
        int "SHT31 Heartbeat Interval (ms)"
        default 60000
        help
            Temps maximum (en ms) avant de forcer une publication, même sans variation de delta.

    config SHT31_ERROR_LOG_FIRST_COUNT
        int "SHT31 Error Log First Count"
        default 2
        help
            Nombre d'erreurs consécutives avant d'afficher le premier log d'avertissement (Filtre le bruit unique).

    config SHT31_ERROR_LOG_EVERY_COUNT
        int "SHT31 Error Log Every Count"
        default 10
        help
            Intervalle de logs pour les erreurs consécutives les suivantes.

    config SHT31_RECOVER_AFTER_CONSECUTIVE_ERRORS
        int "SHT31 Recover After Consecutive Errors"
        default 5
        help
            Nombre d'erreurs consécutives avant de tenter une récupération matérielle. (Doit être > FIRST_COUNT).

    config SHT31_RECOVER_INTERVAL_CYCLES
        int "SHT31 Recover Interval Cycles"
        default 5
        help
            Évite de saturer le bus en ignorant le recover pendant X cycles avant la prochaine tentative.

endmenu
```

## components/system_manager/Kconfig.system_manager
```kconfig
menu "Configuration du système"

    config I2C_SCL_GPIO
        int "GPIO pour I2C SCL"
        default 8

    config I2C_SDA_GPIO
        int "GPIO pour I2C SDA"
        default 9

    config I2C_SCANNER_DEBUG
        bool "Activer le scanner I2C au démarrage"
        default y
        help
            Affiche la liste des périphériques I2C détectés lors de l'initialisation.

endmenu
```

## components/thermostat_task/Kconfig.thermostat_task
```kconfig
menu "Thermostat Task"

    config THERMOSTAT_TASK_INTERVAL_MS
        int "DHT READ INTERVAL MS"
        range 2000 10000
        default 2000

    config THERMOSTAT_TASK_PRIORITY
        int "DHT task priority"
        default 5
    
    config THERMOSTAT_STACK_SIZE
        int "DHT stack size"
        default 4096

endmenu
```

## components/weather/Kconfig.weather
```kconfig
menu "Configuration Météo"

    config OPEN_WEATHER_MAP_KEY
        string "Clé API OpenWeatherMap"
        default "70a685fb0de842b5f2ec972448504339"
        help
            Entrez votre clé API OpenWeatherMap.
            Vous pouvez obtenir une clé gratuite sur https://openweathermap.org/api.

    config WEATHER_LAT
        float "Latitude"
        default 48.8566
        range -90.0 90.0
        help
            Latitude de votre emplacement (ex. 48.8566 pour Paris).

    config WEATHER_LON
        float "Longitude"
        default 2.3522
        range -180.0 180.0
        help
            Longitude de votre emplacement (ex. 2.3522 pour Paris).

    config WEATHER_UPDATE_INTERVAL_MINUTES
        int "Intervalle de mise à jour (minutes)"
        default 60
        range 10 1440
        help
            Intervalle entre les mises à jour des données météo (en minutes).

endmenu
```

## main/Kconfig.projbuild
```kconfig
menu "Thermostat Configuration"

    menu "Matériel et Capteurs"
        rsource "../components/dht/Kconfig.dht"
        rsource "../components/sht31/Kconfig.sht31"
        rsource "../components/relay/Kconfig.relay"
    endmenu

    menu "Evènements"
        rsource "../components/event_bus/Kconfig.event_bus"
    endmenu

    menu "Thermostat"
        rsource "../components/thermostat_task/Kconfig.thermostat_task"
    endmenu

    menu "Système"
        rsource "../components/system_manager/Kconfig.system_manager"
        rsource "../components/wifi_app/Kconfig.wifi"
    endmenu

endmenu
```
